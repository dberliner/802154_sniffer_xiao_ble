## app/sample.yaml
```yaml
sample:
  description: IEEE 802.15.4 Sniffer sample
  name: IEEE 802.15.4 Sniffer
tests:
  sample.peripheral.802154_sniffer:
    sysbuild: true
    build_only: true
    integration_platforms:
      - xiao_ble/nrf52840
    platform_allow:
      - xiao_ble/nrf52840
    tags:
      - ci_build
      - sysbuild
      - ci_samples_peripheral_802154
```

## west.yml
```yaml
# Example application-specific west.yml, using manifest imports.
manifest:
  remotes:
    - name: ncs
      url-base: https://github.com/nrfconnect
  projects:
    - name: nrf
      remote: ncs
      repo-path: sdk-nrf
      revision: v3.0.2
      import: true
  self:
    path: 802154_sniffer_xiao
```
